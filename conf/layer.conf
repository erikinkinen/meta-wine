## conf/layer.conf
```bitbake
# We have a conf and classes directory, add to BBPATH
BBPATH .= ":${LAYERDIR}"

# We have recipes-* directories, add to BBFILES
BBFILES += "${LAYERDIR}/recipes-*/*/*.bb \
            ${LAYERDIR}/recipes-*/*/*.bbappend"

BBFILE_COLLECTIONS += "meta-wine"
BBFILE_PATTERN_meta-wine = "^${LAYERDIR}/"
BBFILE_PRIORITY_meta-wine = "6"

LAYERDEPENDS_meta-wine = "core"
LAYERSERIES_COMPAT_meta-wine = "scarthgap"

# Default runtime Wine provider. Images can still install a concrete variant
# such as wine-staging explicitly.
PREFERRED_RPROVIDER_virtual-wine ?= "wine-stable"
```
